const unsigned int onoff[] PROGMEM = {4500, 4450, 550, 1700, 500, 1700, 550, 1700, 500, 600, 550, 550, 550,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 1700, 550}; //AnalysIR Batch Export - RAW
const unsigned int eins[]  PROGMEM = {4500, 4450, 550, 1650, 550, 1650, 550, 1650, 550, 550, 550, 600, 500,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 1650, 550};
const unsigned int zwei[]  PROGMEM = {4500, 4450, 500, 1700, 500, 1700, 500, 1700, 500, 600, 550, 550, 550,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 1700, 500};
const unsigned int drei[]  PROGMEM = {4500, 4400, 550, 1650, 550, 1700, 500, 1700, 500, 600, 500, 600, 500,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 1700, 500};
const unsigned int vier[]  PROGMEM = {4500, 4450, 500, 1700, 500, 1700, 500, 1700, 500, 600, 500, 600, 500,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 1700, 500};
const unsigned int fuenf[] PROGMEM = {4500, 4450, 500, 1700, 500, 1700, 550, 1650, 550, 550, 550, 550, 550,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 1650, 550};
const unsigned int sechs[] PROGMEM = {4500, 4450, 550, 1650, 550, 1650, 550, 1650, 550, 600, 500, 600, 500,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 1700, 500};
const unsigned int sieben[]PROGMEM = {4500, 4400, 550, 1650, 550, 1700, 500, 1700, 500, 600, 500, 600, 500,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 1700, 500};
const unsigned int acht [] PROGMEM = {4500, 4450, 500, 1700, 550, 1650, 550, 1650, 550, 550, 550, 600, 500,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 1700, 500};
const unsigned int neun [] PROGMEM = {4500, 4450, 500, 1700, 500, 1700, 500, 1700, 500, 600, 500, 600, 500,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 1700, 550};
const unsigned int zero [] PROGMEM = {4500, 4450, 500, 1700, 500, 1700, 500, 1700, 500, 600, 500, 600, 500,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 1700, 550};
const unsigned int source[]PROGMEM = {4500, 4400, 550, 1650, 550, 1650, 550, 1700, 500, 600, 500, 600, 500,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 1650, 550};
const unsigned int txt []  PROGMEM = {4500, 4400, 550, 1650, 550, 1700, 500, 1700, 500, 600, 500, 600, 500,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 1700, 500};
const unsigned int mute [] PROGMEM = {4500, 4400, 550, 1650, 550, 1650, 550, 1650, 550, 550, 550, 550, 550,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 1650, 550};
const unsigned int lauter []PROGMEM = {4450, 4450, 500, 1700, 500, 1700, 500, 1700, 500, 600, 500, 600, 500,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 1750, 450};
const unsigned int leiser []PROGMEM = {4450, 4400, 550, 1700, 500, 1700, 500, 1700, 500, 600, 500, 600, 500,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 1700, 500};
const unsigned int phoch [] PROGMEM = {4450, 4400, 550, 1700, 550, 1650, 550, 1650, 550, 550, 550, 600, 500,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 1700, 500};
const unsigned int prunter[]PROGMEM = {4450, 4400, 550, 1650, 550, 1650, 550, 1700, 500, 550, 550, 550, 550,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 1650, 550};
const unsigned int menu []  PROGMEM = {4450, 4450, 550, 1650, 550, 1650, 550, 1650, 550, 550, 550, 550, 550,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 1650, 550};
const unsigned int smarthub[]PROGMEM = {4450, 4450, 550, 1650, 550, 1650, 550, 1650, 550, 550, 550, 600, 500,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 1700, 500};
const unsigned int guide [] PROGMEM = {4450, 4400, 550, 1700, 550, 1650, 550, 1650, 550, 550, 550, 550, 550,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 1700, 500};
const unsigned int tools [] PROGMEM = {4450, 4450, 500, 1700, 500, 1700, 500, 1700, 500, 600, 500, 600, 500,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 1700, 500};
const unsigned int info []  PROGMEM = {4450, 4450, 500, 1700, 550, 1650, 550, 1650, 550, 550, 550, 550, 550,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 1650, 550};
const unsigned int sreturn[]PROGMEM = {4400, 4450, 500, 1700, 550, 1700, 500, 1650, 550, 550, 550, 600, 500,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 1700, 500};
const unsigned int sexit [] PROGMEM = {4450, 4400, 550, 1650, 550, 1650, 550, 1650, 550, 550, 550, 550, 550,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 1700, 500};
const unsigned int links [] PROGMEM = {4400, 4450, 500, 1700, 500, 1700, 500, 1700, 500, 600, 500, 650, 450,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 1700, 550};
const unsigned int hoch []  PROGMEM = {4450, 4450, 500, 1650, 550, 1700, 500, 1700, 550, 550, 550, 550, 550,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 1650, 550};
const unsigned int rechts []PROGMEM = {4450, 4450, 500, 1700, 500, 1700, 500, 1700, 500, 600, 500, 600, 500,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 1700, 550};
const unsigned int runter []PROGMEM = {4450, 4400, 550, 1650, 550, 1650, 550, 1700, 500, 600, 500, 600, 500,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 1700, 500};
const unsigned int enter [] PROGMEM = {4500, 4400, 550, 1700, 500, 1650, 550, 1650, 550, 550, 550, 550, 550,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 1650, 550};
const unsigned int a []     PROGMEM = {4450, 4450, 500, 1700, 500, 1700, 500, 1700, 500, 600, 550, 550, 550,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 1700, 550};
const unsigned int b []     PROGMEM = {4500, 4400, 550, 1700, 500, 1700, 500, 1700, 500, 600, 500, 600, 500,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 1700, 500};
const unsigned int c []     PROGMEM = {4450, 4450, 500, 1700, 500, 1700, 500, 1700, 500, 600, 500, 600, 500,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 1650, 550};
const unsigned int d []     PROGMEM = {4450, 4450, 500, 1700, 500, 1700, 500, 1700, 500, 600, 500, 600, 500,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 1700, 550};
const unsigned int rec []   PROGMEM = {4450, 4400, 550, 1700, 550, 1650, 550, 1650, 550, 550, 550, 600, 500,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 1700, 500};
const unsigned int dreid [] PROGMEM = {4450, 4450, 500, 1700, 500, 1700, 500, 1700, 500, 600, 500, 600, 500,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 600, 500};
const unsigned int subt []  PROGMEM = {4450, 4400, 550, 1700, 500, 1700, 500, 1700, 550, 550, 550, 550, 550,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 1700, 500};
const unsigned int stopp [] PROGMEM = {4500, 4450, 500, 1700, 500, 1700, 550, 1650, 550, 550, 550, 550, 550,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 1700, 500};
const unsigned int zspulen[]PROGMEM = {4400, 4450, 500, 1700, 550, 1650, 550, 1650, 550, 550, 550, 550, 550,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 1700, 550};
const unsigned int play []  PROGMEM = {4450, 4400, 550, 1700, 500, 1700, 500, 1700, 500, 600, 500, 600, 500,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 1700, 500};
const unsigned int pause [] PROGMEM = {4500, 4400, 550, 1650, 550, 1700, 500, 1700, 500, 600, 500, 600, 500,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 1650, 550};
const unsigned int vspulen[]PROGMEM = {4450, 4400, 550, 1700, 500, 1700, 500, 1650, 550, 550, 550, 550, 550,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 1650, 550};


void frec() {
  for (counter = 0; counter < 67; counter++) {
    senden[counter] = pgm_read_word_near(rec + counter);
  }

  irsend.sendRaw(senden, sizeof(senden) / sizeof(int), 40);
}

void fleiser() {
  for (counter = 0; counter < 67; counter++) {
    senden[counter] = pgm_read_word_near(leiser + counter);
  }

  while (vcounter > 0) {
    irsend.sendRaw(senden, sizeof(senden) / sizeof(int), 40);
    vcounter--;
    delay(200);
  }
}

void flauter() {
  for (counter = 0; counter < 67; counter++) {
    senden[counter] = pgm_read_word_near(lauter + counter);
  }

  while (vcounter > 0) {
    irsend.sendRaw(senden, sizeof(senden) / sizeof(int), 40);
    vcounter--;
    delay(200);
  }
}

void fsource() {
  for (counter = 0; counter < 67; counter++) {
    senden[counter] = pgm_read_word_near(source + counter);
  }

  irsend.sendRaw(senden, sizeof(senden) / sizeof(int), 40);
}

void fmute() {
  for (counter = 0; counter < 67; counter++) {
    senden[counter] = pgm_read_word_near(mute + counter);
  }

  irsend.sendRaw(senden, sizeof(senden) / sizeof(int), 40);
}

void fguide() {
  for (counter = 0; counter < 67; counter++) {
    senden[counter] = pgm_read_word_near(guide + counter);
  }

  irsend.sendRaw(senden, sizeof(senden) / sizeof(int), 40);
}

void fsmarthub() {
  for (counter = 0; counter < 67; counter++) {
    senden[counter] = pgm_read_word_near(smarthub + counter);
  }

  irsend.sendRaw(senden, sizeof(senden) / sizeof(int), 40);
}


void fhoch() {
  for (counter = 0; counter < 67; counter++) {
    senden[counter] = pgm_read_word_near(hoch + counter);
  }

  irsend.sendRaw(senden, sizeof(senden) / sizeof(int), 40);

}

void frunter() {
  for (counter = 0; counter < 67; counter++) {
    senden[counter] = pgm_read_word_near(runter + counter);
  }
  irsend.sendRaw(senden, sizeof(senden) / sizeof(int), 40);
}

void frechts() {
  for (counter = 0; counter < 67; counter++) {
    senden[counter] = pgm_read_word_near(rechts + counter);
  }

  irsend.sendRaw(senden, sizeof(senden) / sizeof(int), 40);
}

void flinks() {
  for (counter = 0; counter < 67; counter++) {
    senden[counter] = pgm_read_word_near(links + counter);
  }
  irsend.sendRaw(senden, sizeof(senden) / sizeof(int), 40);
}

void ftools() {
  for (counter = 0; counter < 67; counter++) {
    senden[counter] = pgm_read_word_near(tools + counter);
  }

  irsend.sendRaw(senden, sizeof(senden) / sizeof(int), 40);
}

void fenter() {
  for (counter = 0; counter < 67; counter++) {
    senden[counter] = pgm_read_word_near(enter + counter);
  }

  irsend.sendRaw(senden, sizeof(senden) / sizeof(int), 40);

}

void fstop() {
  for (counter = 0; counter < 67; counter++) {
    senden[counter] = pgm_read_word_near(stopp + counter);
  }

  irsend.sendRaw(senden, sizeof(senden) / sizeof(int), 40);

  delay(500);
  flinks();
  delay(500);
  fenter();
}

void fplay() {
  for (counter = 0; counter < 67; counter++) {
    senden[counter] = pgm_read_word_near(play + counter);
  }
  irsend.sendRaw(senden, sizeof(senden) / sizeof(int), 40);
}

void fpause() {
  for (counter = 0; counter < 67; counter++) {
    senden[counter] = pgm_read_word_near(pause + counter);
  }

  irsend.sendRaw(senden, sizeof(senden) / sizeof(int), 40);
}

void freturn() {
  for (counter = 0; counter < 67; counter++) {
    senden[counter] = pgm_read_word_near(sreturn + counter);
  }

  irsend.sendRaw(senden, sizeof(senden) / sizeof(int), 40);
}

void finfo() {
  for (counter = 0; counter < 67; counter++) {
    senden[counter] = pgm_read_word_near(info + counter);
  }

  irsend.sendRaw(senden, sizeof(senden) / sizeof(int), 40);

}

void feins() {
  for (counter = 0; counter < 67; counter++) {
    senden[counter] = pgm_read_word_near(eins + counter);
  }

  irsend.sendRaw(senden, sizeof(senden) / sizeof(int), 40);

  fernseher = 1;
}
void fzwei() {
  for (counter = 0; counter < 67; counter++) {
    senden[counter] = pgm_read_word_near(zwei + counter);
  }


  irsend.sendRaw(senden, sizeof(senden) / sizeof(int), 40);

  fernseher = 1;
}

void fdrei() {
  for (counter = 0; counter < 67; counter++) {
    senden[counter] = pgm_read_word_near(drei + counter);
  }

  irsend.sendRaw(senden, sizeof(senden) / sizeof(int), 40);

  fernseher = 1;
}

void fvier() {
  for (counter = 0; counter < 67; counter++) {
    senden[counter] = pgm_read_word_near(vier + counter);
  }

  irsend.sendRaw(senden, sizeof(senden) / sizeof(int), 40);

  fernseher = 1;
}

void ffuenf() {
  for (counter = 0; counter < 67; counter++) {
    senden[counter] = pgm_read_word_near(fuenf + counter);
  }

  irsend.sendRaw(senden, sizeof(senden) / sizeof(int), 40);

  fernseher = 1;
}

void fsechs() {
  for (counter = 0; counter < 67; counter++) {
    senden[counter] = pgm_read_word_near(sechs + counter);
  }

  irsend.sendRaw(senden, sizeof(senden) / sizeof(int), 40);

  fernseher = 1;
}

void fsieben() {
  for (counter = 0; counter < 67; counter++) {
    senden[counter] = pgm_read_word_near(sieben + counter);
  }

  irsend.sendRaw(senden, sizeof(senden) / sizeof(int), 40);

  fernseher = 1;
}

void facht() {
  for (counter = 0; counter < 67; counter++) {
    senden[counter] = pgm_read_word_near(acht + counter);
  }

  irsend.sendRaw(senden, sizeof(senden) / sizeof(int), 40);

  fernseher = 1;
}

void fneun() {
  for (counter = 0; counter < 67; counter++) {
    senden[counter] = pgm_read_word_near(neun + counter);
  }
  irsend.sendRaw(senden, sizeof(senden) / sizeof(int), 40);

  fernseher = 1;
}

void fnull() {
  for (counter = 0; counter < 67; counter++) {
    senden[counter] = pgm_read_word_near(zero + counter);
  }

  irsend.sendRaw(senden, sizeof(senden) / sizeof(int), 40);

  fernseher = 1;
}

void fon() {
  for (counter = 0; counter < 67; counter++) {
    senden[counter] = pgm_read_word_near(onoff + counter);
  }

  irsend.sendRaw(senden, sizeof(senden) / sizeof(int), 40);
  fernseher = 1;
}

void foff() {

  if (ps == 1) {
    psoff();
    delay(13000);
    ps = 0;
  }

  if (fextt == 1) {
    fint();
    delay(1000);
    fextt = 0;
  }

  for (counter = 0; counter < 67; counter++) {
    senden[counter] = pgm_read_word_near(onoff + counter);
  }

  irsend.sendRaw(senden, sizeof(senden) / sizeof(int), 40);

  fernseher = 0;
}

void flaut() {
  ftools();
  delay(1000);
  if (ps == 0) {
    frunter();
    delay(500);
    fenter();
    delay(500);
    frunter();
    delay(500);
    fenter();
    delay(500);
    freturn();
  }

  if (ps == 1) {
    frunter();
    delay(500);
    frunter();
    delay(500);
    frunter();
    delay(500);
    frunter();
    delay(500);
    fenter();
    delay(500);
    frunter();
    delay(500);
    fenter();
    delay(500);
    freturn();
  }
}

void fext() {
  if (anlage == 0) {
    aon();
    delay(1000);
  }
  a20();
  delay(500);
  advd();
  delay(500);
  flaut();

}

void fint() {
  flaut();
  if (anlage == 1) {
    aoff();
    delay(200);
  }
}
